## CMakeLists.txt
```
# SPDX-License-Identifier: Apache-2.0

cmake_minimum_required(VERSION 3.20.0)

find_package(Zephyr REQUIRED HINTS $ENV{ZEPHYR_BASE})
project(bsim_mesh_nw_sim)

include_directories(
	${ZEPHYR_NRF_MODULE_DIR}/samples/bluetooth/mesh/common
)

target_sources(app PRIVATE
  src/main.c
  src/mesh_test.c
  src/mesh_nw_test.c
  src/mesh_nw_test_vnd_mdl.c
  vnd_mdl/src/vnd_cli.c
  vnd_mdl/src/vnd_srv.c
)

target_include_directories(app PRIVATE
  ${ZEPHYR_NRF_MODULE_DIR}/samples/bluetooth/mesh/common
  ${ZEPHYR_NRF_MODULE_DIR}/subsys/bluetooth/mesh
  vnd_mdl/include
)

zephyr_include_directories(
  ${BSIM_COMPONENTS_PATH}/libUtilv1/src/
  ${BSIM_COMPONENTS_PATH}/libPhyComv1/src/
)
```

## prj.conf
```kconfig
CONFIG_LOG=y
CONFIG_LOG_MODE_IMMEDIATE=y
CONFIG_ASSERT=y
CONFIG_SYS_CLOCK_TICKS_PER_SEC=32768
CONFIG_MAIN_STACK_SIZE=2048
CONFIG_SYSTEM_WORKQUEUE_STACK_SIZE=2048
# CONFIG_BT_HCI_TX_STACK_SIZE=1500
CONFIG_IDLE_STACK_SIZE=320

# Bluetooth configuration
CONFIG_BT=y
CONFIG_BT_CENTRAL=y
CONFIG_BT_PERIPHERAL=y
CONFIG_BT_BUF_CMD_TX_COUNT=4

CONFIG_BT_PRIVACY=n
CONFIG_BT_COMPANY_ID=0x0059
CONFIG_BT_DEVICE_NAME="Mesh test"
CONFIG_BT_OBSERVER=y
CONFIG_BT_BROADCASTER=y
CONFIG_BT_CTLR_ADV_SET=5
CONFIG_BT_EXT_ADV_MAX_ADV_SET=5

# Disable unused Bluetooth features
CONFIG_BT_CTLR_DUP_FILTER_LEN=0
CONFIG_BT_CTLR_PRIVACY=n

# Bluetooth Mesh configuration
CONFIG_BT_MESH=y
CONFIG_BT_MESH_LOG_LEVEL_DBG=y
CONFIG_BT_MESH_SETTINGS_WORKQ_STACK_SIZE=1400
CONFIG_BT_MESH_RELAY=y
CONFIG_BT_MESH_PB_GATT=y
CONFIG_BT_MESH_PB_GATT_CLIENT=y
CONFIG_BT_MESH_GATT_PROXY=y
CONFIG_BT_MESH_PROXY_CLIENT=y
CONFIG_BT_MESH_PROXY_SOLICITATION=y

# CONFIG_SETTINGS=y
# CONFIG_BT_SETTINGS=y
# CONFIG_FLASH=y
# CONFIG_FLASH_MAP=y
# CONFIG_NVS=y
# CONFIG_SECURE_STORAGE=y
# CONFIG_MBEDTLS_PSA_KEY_SLOT_COUNT=64

CONFIG_BT_MESH_RELAY_ADV_SETS=2
CONFIG_BT_MESH_RELAY_BUF_COUNT=10
CONFIG_BT_MESH_RELAY_RETRANSMIT_COUNT=2
CONFIG_BT_MESH_RELAY_RETRANSMIT_INTERVAL=20
CONFIG_BT_MESH_NETWORK_TRANSMIT_COUNT=2
CONFIG_BT_MESH_NETWORK_TRANSMIT_INTERVAL=20
CONFIG_BT_MESH_ACCESS_DELAYABLE_MSG=n
CONFIG_BT_MESH_CRPL=64

CONFIG_BT_MESH_ADV_BUF_COUNT=6
CONFIG_BT_MESH_ADV_EXT_FRIEND_SEPARATE=y
CONFIG_BT_MESH_ADV_EXT_GATT_SEPARATE=y
CONFIG_BT_MESH_MSG_CACHE_SIZE=32
CONFIG_BT_MESH_TX_SEG_MAX=32
CONFIG_BT_MESH_RX_SEG_MAX=32
CONFIG_BT_MESH_TX_SEG_MSG_COUNT=2
CONFIG_BT_MESH_RX_SEG_MSG_COUNT=2
CONFIG_BT_MESH_SEG_BUFS=100
CONFIG_BT_MESH_MODEL_GROUP_COUNT=3
CONFIG_BT_MESH_MOD_ACKD_TIMEOUT_BASE=6000

CONFIG_BT_MESH_LOW_POWER=y
CONFIG_BT_MESH_LPN_AUTO=n
CONFIG_BT_MESH_FRIEND=y
CONFIG_BT_MESH_FRIEND_ENABLED=n
CONFIG_BT_MESH_FRIEND_LPN_COUNT=2
CONFIG_BT_MESH_APP_KEY_COUNT=2
CONFIG_BT_MESH_SUBNET_COUNT=5
CONFIG_BT_MESH_MODEL_KEY_COUNT=2
CONFIG_BT_MESH_MODEL_EXTENSIONS=y
CONFIG_BT_MESH_LABEL_COUNT=3
CONFIG_BT_MESH_IV_UPDATE_TEST=y
CONFIG_BT_MESH_PB_ADV=y
CONFIG_BT_MESH_PROVISIONEE=y

CONFIG_BT_MESH_PROVISIONER=y
CONFIG_BT_MESH_CDB=y
CONFIG_BT_MESH_CDB_NODE_COUNT=5
CONFIG_BT_MESH_CDB_SUBNET_COUNT=4
CONFIG_BT_MESH_PROV_OOB_PUBLIC_KEY=y
CONFIG_BT_MESH_COMP_PAGE_1=y
CONFIG_BT_MESH_COMP_PAGE_2=y

CONFIG_BT_MESH_CFG_CLI=y
CONFIG_BT_MESH_HEALTH_CLI=y
CONFIG_BT_TESTING=y

# Increase the number of key slots in PSA Crypto core
CONFIG_MBEDTLS_PSA_KEY_SLOT_COUNT=64

CONFIG_BT_LL_SOFTDEVICE=y
```

## src/main.c
```c
/*
 * Copyright (c) 2025 Nordic Semiconductor ASA
 *
 * SPDX-License-Identifier: Apache-2.0
 */
#include <stddef.h>

#include "bstests.h"
#include "mesh_test.h"

extern struct bst_test_list *test_network_tst_install(struct bst_test_list *tests);
extern struct bst_test_list *test_vnd_mdl_install(struct bst_test_list *tests);

bst_test_install_t test_installers[] = {
	test_network_tst_install,
	test_vnd_mdl_install,
	NULL
};

static struct k_thread bsim_mesh_thread;
static K_KERNEL_STACK_DEFINE(bsim_mesh_thread_stack, 4096);

static void bsim_mesh_entry_point(void *unused1, void *unused2, void *unused3)
{
	bst_main();
}

int main(void)
{
	k_thread_create(&bsim_mesh_thread, bsim_mesh_thread_stack,
			K_KERNEL_STACK_SIZEOF(bsim_mesh_thread_stack), bsim_mesh_entry_point, NULL,
			NULL, NULL, K_PRIO_COOP(1), 0, K_NO_WAIT);
	k_thread_name_set(&bsim_mesh_thread, "BabbleSim Bluetooth Mesh tests");

	return 0;
}
```

## src/mesh_nw_test.c
```c
/*
 * Copyright (c) 2025 Nordic Semiconductor ASA
 *
 * SPDX-License-Identifier: Apache-2.0
 */
#include "mesh_test.h"

#include <zephyr/kernel.h>
#include "bs_tracing.h"
#include "bs_utils.h"
#include "bsim_args_runner.h"


#define LOG_MODULE_NAME mesh_nw_test
#include <zephyr/logging/log.h>
LOG_MODULE_REGISTER(LOG_MODULE_NAME);

extern int max_iterations;
extern int dut_list[MAX_DEVICES];
extern int dut_count;
extern int net_id_counts;

#define WAIT_TIME (max_iterations * MAX_DEVICES * 2)

extern enum bst_result_t bst_result;

extern uint8_t dev_key[16];
extern uint8_t app_key[16];
extern uint8_t app_idx;
extern uint8_t net_key[16];
extern uint8_t net_idx;

extern struct test_results tst_res[MAX_DEVICES];

static struct bt_mesh_prov prov;
static struct bt_mesh_cfg_cli cfg_cli;
static struct bt_mesh_health_srv health_srv;
static struct bt_mesh_model_pub health_pub = {
	.msg = NET_BUF_SIMPLE(BT_MESH_TX_SDU_MAX),
};

static void health_attention_status(struct bt_mesh_health_cli *cli,
				    uint16_t addr, uint8_t attention)
{
	LOG_INF("Health Attention Status from 0x%04x: %u", addr, attention);
}

static struct bt_mesh_health_cli health_cli = {
	.current_status = NULL,
	.fault_status = NULL,
	.attention_status = health_attention_status,
	.period_status = NULL,
};

static const struct bt_mesh_elem elems[] = {
	BT_MESH_ELEM(1,
		MODEL_LIST(BT_MESH_MODEL_CFG_SRV,
			   BT_MESH_MODEL_CFG_CLI(&cfg_cli),
			   BT_MESH_MODEL_HEALTH_SRV(&health_srv, &health_pub),
			   BT_MESH_MODEL_HEALTH_CLI(&health_cli)),
		BT_MESH_MODEL_NONE),
};

static const struct bt_mesh_comp comp = {
	.elem = elems,
	.elem_count = ARRAY_SIZE(elems),
};

static void additional_configure(uint16_t addr)
{
	uint8_t status;
	int err;

	/* Bind AppKey to Health Server and Client */
	err = bt_mesh_cfg_cli_mod_app_bind(net_idx, addr, addr, app_idx,
					   BT_MESH_MODEL_ID_HEALTH_SRV, &status);
	if (err || status) {
		FAIL("Model 0x%04x bind failed (err %d, status %u)", BT_MESH_MODEL_ID_HEALTH_SRV, err,
		     status);
		return;
	}

	err = bt_mesh_cfg_cli_mod_app_bind(net_idx, addr, addr, app_idx,
					   BT_MESH_MODEL_ID_HEALTH_CLI, &status);
	if (err || status) {
		FAIL("Model 0x%04x bind failed (err %d, status %u)", BT_MESH_MODEL_ID_HEALTH_SRV, err,
		     status);
		return;
	}

}

static void dev_prov_and_conf(uint16_t addr)
{
	/* Do self provisioning and configuration to keep test bench simple. */
	bt_mesh_tst_provision(addr);
	bt_mesh_tst_common_configure(addr);
	additional_configure(addr);
}

static void test_node_device_init(void)
{
	bt_mesh_test_cfg_set(WAIT_TIME);
}

static void test_node_device(void)
{
	bst_result = In_progress;
	LOG_INF("Hello :simid %s nbr %d", bsim_args_get_simid(), bsim_args_get_global_device_nbr());

	bt_mesh_device_setup(&prov, &comp);
	dev_prov_and_conf(bsim_args_get_global_device_nbr() + 1);

	PASS();
}

/* Parse command line arguments */
static void test_args_parse(int argc, char *argv[])
{
	static char *duts_str;

	bs_args_struct_t args_struct[] = {
		{
			.dest = &max_iterations,
			.type = 'i',
			.name = "{integer}",
			.option = "iterations",
			.descript = "Number of iterations to run for each test"
		},
		{
			.dest = &duts_str,
			.type = 's',
			.name = "{string}",
			.option = "duts",
			.descript = "Comma-separated list of DUT indices to test"
		},
		ARG_TABLE_ENDMARKER
	};

	bs_args_parse_all_cmd_line(argc, argv, args_struct);

	if (max_iterations < 1 || max_iterations > MAX_ITERATIONS) {
		FAIL("Invalid number of given iterations %d. Max allowed %d", max_iterations,
		     MAX_ITERATIONS);
	}

	dut_count = ARRAY_SIZE(dut_list);
	parse_dut_list(duts_str, dut_list, &dut_count);
}

static void test_node_tester_init(void)
{
	bt_mesh_test_cfg_set(WAIT_TIME);
}

static void test_node_tester(void)
{
	int err;
	int64_t t1, t2;

	/* Note: Tester device is instantiated at last in test script, and hence this is also
	 * equal to total number of devices in the network.
	 */
	int total_nodes = bsim_args_get_global_device_nbr() + 1;
	uint16_t tester_addr = total_nodes;
	ASSERT_TRUE_MSG(total_nodes <= MAX_DEVICES, "Edit MAX_DEVICES and recompile");
	LOG_INF("Total Devices : %d", total_nodes);

	/* Setup the device */
	bt_mesh_device_setup(&prov, &comp);

	/* Assign unicast address (simulation ID + 1) and configure it.
	 * Note: device composition has only one element therefore we can just use
	 * (simulation ID + 1) as address.
	 */
	dev_prov_and_conf(tester_addr);

	LOG_INF("Using MAX_ITERATIONS: %d", max_iterations);

	/* Print DUT list if specified */
	if (dut_count > 0) {
		LOG_INF("Testing specific DUTs:");
		for (int i = 0; i < dut_count; i++) {
			LOG_INF("  DUT %d: Device Addr 0x%04x", dut_list[i], dut_list[i] + 1);
		}
	}

	for(int dut = 0; dut < total_nodes; dut++)
	{
		/* Skip if not in DUT list */
		if (!is_dut(dut, dut_list, dut_count)) {
			continue;
		}

		int dut_addr = dut + 1;

		tst_res[dut].d_id = dut;
		tst_res[dut].addr = dut_addr;
		tst_res[dut].failures = 0;

		LOG_INF("Testing latency for Dev: 0x%04x (ID: %d) Tester: 0x%04x", dut_addr,
			 dut, tester_addr);

		for (int i = 0; i < max_iterations; i++) {

			struct bt_mesh_msg_ctx ctx = {0};
			uint8_t attention;

			ctx.net_idx = net_idx;
			ctx.app_idx = app_idx;
			ctx.addr = dut_addr;
			ctx.send_ttl = MAX_TTL;
			ctx.send_rel = 0;

			t1 = k_uptime_get();
			err = bt_mesh_health_cli_attention_get(&health_cli, &ctx, &attention);

			if (err) {
				LOG_ERR("Health Attention Get failed (err %d)", err);
				tst_res[dut].failures++;
				k_sleep(K_MSEC(200));
				continue;
			}

			t2 = k_uptime_get();
			tst_res[dut].latency[i] = t2 - t1;

			LOG_INF("Latency: %d", tst_res[dut].latency[i]);

			k_sleep(K_MSEC(1200));
		}

		LOG_INF("Network ID advertisements count %d", net_id_counts);
	}

	print_common_results(total_nodes, max_iterations);

	PASS();

	bs_trace_silent_exit(0);
}

static void test_pre_init(void)
{
	bt_mesh_tst_conn_adv_cnt_init();
}

static void test_terminate(void)
{
	bt_mesh_tst_conn_adv_cnt_finish();
}

#define TEST_CASE(role, name, description)                       \
	{                                                        \
		.test_id = #role "_" #name,                      \
		.test_descr = description,                       \
		.test_pre_init_f = test_pre_init,                \
		.test_tick_f = bt_mesh_test_timeout,             \
		.test_args_f = test_args_parse,                  \
		.test_post_init_f = test_##role##_##name##_init, \
		.test_main_f = test_##role##_##name,             \
		.test_delete_f = test_terminate,              \
	}

static const struct bst_test_instance test_network[] = {
	TEST_CASE(node, device, "Nodes in the network"),
	TEST_CASE(node, tester, "tester device"),
	BSTEST_END_MARKER
};

struct bst_test_list *test_network_tst_install(struct bst_test_list *tests)
{
	tests = bst_add_tests(tests, test_network);
	return tests;
}
```

## src/mesh_nw_test_vnd_mdl.c
```c
/*
 * Copyright (c) 2025 Nordic Semiconductor ASA
 *
 * SPDX-License-Identifier: Apache-2.0
 */
#include "mesh_test.h"

#include <zephyr/kernel.h>
#include <bluetooth/mesh/models.h>
#include <zephyr/bluetooth/mesh/proxy.h>
#include "bs_tracing.h"
#include "bs_utils.h"
#include "bsim_args_runner.h"
#include "argparse.h"
#include <vnd_cli.h>
#include <vnd_srv.h>

#define LOG_MODULE_NAME mnt_vnd_mdl
#include <zephyr/logging/log.h>
LOG_MODULE_REGISTER(LOG_MODULE_NAME);

extern int max_iterations;
extern int dut_list[MAX_DEVICES];
extern int dut_count;
extern int net_id_counts;

#define WAIT_TIME (max_iterations * MAX_DEVICES * 6)

extern enum bst_result_t bst_result;

extern uint8_t dev_key[16];
extern uint8_t app_key[16];
extern uint8_t app_idx;
extern uint8_t net_key[16];
extern uint8_t net_idx;

extern struct test_results tst_res[MAX_DEVICES];

static struct bt_mesh_prov prov;
static struct bt_mesh_cfg_cli cfg_cli;
static struct bt_mesh_health_srv health_srv;
static struct bt_mesh_model_pub health_pub = {
	.msg = NET_BUF_SIMPLE(BT_MESH_TX_SDU_MAX),
};

/* Sample message buffer */
static const char set_msg[] =
"Hello World- 0123456789ABCDEF0123456789ABCDEF0123456789ABCDEF0123456789ABCDEF0123456789ABCDEF0123456789ABCDEF0123456789ABCDEF0123456789ABCDEF0123456789ABCDEF0123456789ABCDEF0123456789ABCDEF0123456789ABCDEF0123456789ABCDEF0123456789ABCDEF0123456789ABCDEF0123456789ABCDEF0123456789ABCDEF0123456789ABCDEF";
static const char status_msg[] =
"Response OK- 0123456789ABCDEF0123456789ABCDEF0123456789ABCDEF0123456789ABCDEF0123456789ABCDEF0123456789ABCDEF0123456789ABCDEF0123456789ABCDEF0123456789ABCDEF0123456789ABCDEF0123456789ABCDEF0123456789ABCDEF0123456789ABCDEF0123456789ABCDEF0123456789ABCDEF0123456789ABCDEF0123456789ABCDEF0123456789ABCDEF";

/**************************************************************************************************/
/* Vendor model operation callbacks */
static int handle_vendor_set(struct bt_mesh_vendor_srv *srv,
				struct bt_mesh_msg_ctx *ctx,
				const struct bt_mesh_vendor_set *set,
				struct bt_mesh_vendor_status *rsp);

static int handle_vendor_get(struct bt_mesh_vendor_srv *srv,
				struct bt_mesh_msg_ctx *ctx,
				const struct bt_mesh_vendor_get *get,
				struct bt_mesh_vendor_status *rsp);

static const struct bt_mesh_vendor_srv_handlers vendor_srv_handlers = {
	.set = handle_vendor_set,
	.get = handle_vendor_get,
};

/* Server model instance */
static struct bt_mesh_vendor_srv vendor_srv = BT_MESH_VENDOR_SRV_INIT(&vendor_srv_handlers);

/* Server set callback */
static int handle_vendor_set(struct bt_mesh_vendor_srv *srv,
				struct bt_mesh_msg_ctx *ctx,
				const struct bt_mesh_vendor_set *set,
				struct bt_mesh_vendor_status *rsp)
{
	char data[BT_MESH_VENDOR_MSG_MAXLEN_SET + 1] = {0};
	size_t len = set->buf->len;

	/* Safety check for buffer size */
	if (len > BT_MESH_VENDOR_MSG_MAXLEN_SET) {
		len = BT_MESH_VENDOR_MSG_MAXLEN_SET;
	}

	/* Copy data for display */
	if (len > 0) {
		memcpy(data, set->buf->data, len);
		data[len] = '\0'; /* Null-terminate the string */
	}

	LOG_DBG("Received SET message: \"%s\"", data);

	/* Populate the response status message */
	net_buf_simple_reset(rsp->buf);
	net_buf_simple_add_mem(rsp->buf, status_msg, strlen(status_msg));

	return 0; /* Return success to send response immediately */
}

/* Server get callback */
static int handle_vendor_get(struct bt_mesh_vendor_srv *srv,
				struct bt_mesh_msg_ctx *ctx,
				const struct bt_mesh_vendor_get *get,
				struct bt_mesh_vendor_status *rsp)
{
	size_t len = strlen(status_msg);

	/* Check if length parameter is provided and limit response accordingly */
	if (get) {
		len = (get->length < len) ? get->length : len;

		LOG_INF("GET with length: %u", get->length);
	} else {
		LOG_INF("GET without length, sending full response");
	}

	/* Populate the response status message */
	net_buf_simple_reset(rsp->buf);
	net_buf_simple_add_mem(rsp->buf, status_msg, len);

	LOG_INF("Sending STATUS response with length: %zu", len);

	return 0; /* Return success to send response immediately */
}

/**************************************************************************************************/
/* Vendor model client operation callbacks */
/* Forward declaration for the client status handler */
static void handle_vendor_status(struct bt_mesh_vendor_cli *cli,
				  struct bt_mesh_msg_ctx *ctx,
				  const struct bt_mesh_vendor_status *status);

/* Client model instance */
static struct bt_mesh_vendor_cli vendor_cli = BT_MESH_VND_CLI_INIT(handle_vendor_status);

/* Client status callback */
static void handle_vendor_status(struct bt_mesh_vendor_cli *cli,
				  struct bt_mesh_msg_ctx *ctx,
				  const struct bt_mesh_vendor_status *status)
{
	char data[BT_MESH_VENDOR_MSG_MAXLEN_STATUS + 1] = {0};
	size_t len = status->buf->len;

	if (len > BT_MESH_VENDOR_MSG_MAXLEN_STATUS) {
		len = BT_MESH_VENDOR_MSG_MAXLEN_STATUS;
	}

	if (len > 0) {
		memcpy(data, status->buf->data, len);
		data[len] = '\0'; /* Null-terminate the string */
	}

	LOG_DBG("Received STATUS: len %d ttl %d", len, ctx->recv_ttl);
}


int vendor_model_send_set(const uint8_t *data, size_t len, struct bt_mesh_msg_ctx *ctx,
			  struct bt_mesh_vendor_status *rsp)
{
	LOG_DBG("Sending SET message: \"%s\" (%d)", (char *)data, len);

	NET_BUF_SIMPLE_DEFINE(temp_buf, BT_MESH_VENDOR_MSG_MAXLEN_SET);
	net_buf_simple_add_mem(&temp_buf, data, len);

	struct bt_mesh_vendor_set set = {
		.buf = &temp_buf
	};

	return bt_mesh_vendor_cli_set(&vendor_cli, ctx, &set, rsp);
}

int vendor_model_send_set_unack(const uint8_t *data, size_t len, struct bt_mesh_msg_ctx *ctx)
{
	LOG_DBG("Sending SET UNACK message: \"%s\" (%d)", (char *)data, len);

	NET_BUF_SIMPLE_DEFINE(temp_buf, BT_MESH_VENDOR_MSG_MAXLEN_SET);
	net_buf_simple_add_mem(&temp_buf, data, len);

	struct bt_mesh_vendor_set set = {
		.buf = &temp_buf
	};

	return bt_mesh_vendor_cli_set_unack(&vendor_cli, ctx, &set);
}

/**************************************************************************************************/

static const struct bt_mesh_elem elems[] = {
	BT_MESH_ELEM(1,
		MODEL_LIST(BT_MESH_MODEL_CFG_SRV,
			   BT_MESH_MODEL_CFG_CLI(&cfg_cli),
			   BT_MESH_MODEL_HEALTH_SRV(&health_srv, &health_pub)),
		BT_MESH_MODEL_LIST(
			BT_MESH_MODEL_VND_SRV(&vendor_srv, &vendor_srv_handlers),
			BT_MESH_MODEL_VND_CLI(&vendor_cli))
	),
};

static const struct bt_mesh_comp comp = {
	.elem = elems,
	.elem_count = ARRAY_SIZE(elems),
};

static void additional_configure(uint16_t addr)
{
	uint8_t status;
	int err;

	/* Bind AppKey to Vendor Server and Client */
	err = bt_mesh_cfg_cli_mod_app_bind_vnd(net_idx, addr, addr, app_idx,
					   BT_MESH_MODEL_ID_VENDOR_SRV, BT_COMP_ID_VENDOR, &status);
	if (err || status) {
		FAIL("Model 0x%04x bind failed (err %d, status %u)", BT_MESH_MODEL_ID_VENDOR_SRV, err,
		     status);
		return;
	}

	err = bt_mesh_cfg_cli_mod_app_bind_vnd(net_idx, addr, addr, app_idx,
					   BT_MESH_MODEL_ID_VENDOR_CLI, BT_COMP_ID_VENDOR, &status);
	if (err || status) {
		FAIL("Model 0x%04x bind failed (err %d, status %u)", BT_MESH_MODEL_ID_VENDOR_CLI, err,
		     status);
		return;
	}
}

static void dev_prov_and_conf(uint16_t addr)
{
	/* Do self provisioning and configuration to keep test bench simple. */
	bt_mesh_tst_provision(addr);
	bt_mesh_tst_common_configure(addr);
	additional_configure(addr);
}

static void test_vnd_node_device_init(void)
{
	bt_mesh_test_cfg_set(WAIT_TIME);
}

static void test_vnd_node_device(void)
{
	bst_result = In_progress;
	LOG_INF("Hello :simid %s nbr %d", bsim_args_get_simid(), bsim_args_get_global_device_nbr());

	bt_mesh_device_setup(&prov, &comp);
	dev_prov_and_conf(bsim_args_get_global_device_nbr() + 1);

	PASS();
}

static void test_vnd_node_tester_init(void)
{
	bt_mesh_test_cfg_set(WAIT_TIME);
}

static void test_vnd_node_tester(void)
{
	int err;
	int64_t t1, t2;

	/* Note: Tester device is instantiated at last in test script, and hence this is also
	 * equal to total number of devices in the network.
	 */
	int total_nodes = bsim_args_get_global_device_nbr() + 1;
	uint16_t tester_addr = total_nodes;
	ASSERT_TRUE_MSG(total_nodes <= MAX_DEVICES, "Edit MAX_DEVICES and recompile");
	LOG_INF("Total Devices : %d", total_nodes);

	/* Setup the device */
	bt_mesh_device_setup(&prov, &comp);

	/* Assign unicast address (simulation ID + 1) and configure it.
	 * Note: device composition has only one element therefore we can just use
	 * (simulation ID + 1) as address.
	 */
	dev_prov_and_conf(tester_addr);

	LOG_INF("Using MAX_ITERATIONS: %d", max_iterations);

	/* Print DUT list if specified */
	if (dut_count > 0) {
		LOG_INF("Testing specific DUTs:");
		for (int i = 0; i < dut_count; i++) {
			LOG_INF("  DUT %d: Device Addr 0x%04x", dut_list[i], dut_list[i] + 1);
		}
	}

	/* For each node, send attention get 10 times and store latency information */
	struct bt_mesh_vendor_status rsp = {0};
	struct bt_mesh_msg_ctx ctx = {0};

	for(int dut = 0; dut < total_nodes; dut++)
	{
		/* Skip if not in DUT list */
		if (!is_dut(dut, dut_list, dut_count)) {
			continue;
		}

		int dut_addr = dut + 1;

		tst_res[dut].d_id = dut;
		tst_res[dut].addr = dut_addr;
		tst_res[dut].failures = 0;

		LOG_INF("Testing latency for Dev: 0x%04x (ID: %d) Tester: 0x%04x", dut_addr,
			 dut, tester_addr);

		for (int i = 0; i < max_iterations; i++) {

			ctx.net_idx = net_idx;
			ctx.app_idx = app_idx;
			ctx.addr = dut_addr;
			ctx.send_ttl = MAX_TTL;
			ctx.send_rel = 0;

			t1 = k_uptime_get();
			err = vendor_model_send_set((const uint8_t *)set_msg, strlen(set_msg),
						    &ctx, &rsp);

			if (err) {
				LOG_ERR("Vendor Set failed (err %d)", err);
				tst_res[dut].failures++;
				k_sleep(K_MSEC(200));
				continue;
			}

			t2 = k_uptime_get();
			tst_res[dut].latency[i] = t2 - t1;

			LOG_INF("Latency: %d", tst_res[dut].latency[i]);

			k_sleep(K_MSEC(1500));
		}

		LOG_INF("Network ID advertisements count %d", net_id_counts);
	}

	print_common_results(total_nodes, max_iterations);

	PASS();

	bs_trace_silent_exit(0);
}

static void test_pre_init(void)
{
	bt_mesh_tst_conn_adv_cnt_init();
}

static void test_terminate(void)
{
	bt_mesh_tst_conn_adv_cnt_finish();
}

/* Parse command line arguments */
static void test_args_parse(int argc, char *argv[])
{
	static char *duts_str;

	bs_args_struct_t args_struct[] = {
		{
			.dest = &max_iterations,
			.type = 'i',
			.name = "{integer}",
			.option = "iterations",
			.descript = "Number of iterations to run for each test"
		},
		{
			.dest = &duts_str,
			.type = 's',
			.name = "{string}",
			.option = "duts",
			.descript = "Comma-separated list of DUT indices to test"
		},
		ARG_TABLE_ENDMARKER
	};

	bs_args_parse_all_cmd_line(argc, argv, args_struct);

	if (max_iterations < 1 || max_iterations > MAX_ITERATIONS) {
		FAIL("Invalid number of given iterations %d. Max allowed %d", max_iterations,
		     MAX_ITERATIONS);
	}

	dut_count = ARRAY_SIZE(dut_list);
	parse_dut_list(duts_str, dut_list, &dut_count);
}

#define TEST_CASE(role, name, description)                       \
	{                                                        \
		.test_id = #role "_" #name,                      \
		.test_descr = description,                       \
		.test_pre_init_f = test_pre_init,                \
		.test_tick_f = bt_mesh_test_timeout,             \
		.test_args_f = test_args_parse,                  \
		.test_post_init_f = test_##role##_##name##_init, \
		.test_main_f = test_##role##_##name,             \
		.test_delete_f = test_terminate,                 \
	}

static const struct bst_test_instance test_network[] = {
	TEST_CASE(vnd_node, device, "Vendor model nodes in the network"),
	TEST_CASE(vnd_node, tester, "Vendor model tester device"),
	BSTEST_END_MARKER
};

struct bst_test_list *test_vnd_mdl_install(struct bst_test_list *tests)
{
	tests = bst_add_tests(tests, test_network);
	return tests;
}
```

## src/mesh_test.c
```c
/*
 * Copyright (c) 2025 Nordic Semiconductor ASA
 *
 * SPDX-License-Identifier: Apache-2.0
 */

#include "mesh_test.h"

#include <zephyr/kernel.h>
#include "bs_tracing.h"
#include "time_machine.h"

#define LOG_MODULE_NAME mesh_test
#include <zephyr/logging/log.h>
LOG_MODULE_REGISTER(LOG_MODULE_NAME);

/* Common test variables */
int max_iterations = DEF_ITERATIONS;

/* DUT list handling */
int dut_list[MAX_DEVICES];
int dut_count = 0;

int net_id_counts;

uint8_t dev_key[16] = { 0xdd };
uint8_t app_key[16] = { 0xaa };
uint8_t app_idx = 0;
uint8_t net_key[16] = { 0xcc };
uint8_t net_idx = 0;

struct test_results tst_res[MAX_DEVICES];


/* Scanner callback function */
static void scan_packet_recv(const struct bt_le_scan_recv_info *info, struct net_buf_simple *buf)
{
    if (info->adv_type == BT_GAP_ADV_TYPE_ADV_IND) {
        /* FIXME: Parse advertisement data and find out Mesh Proxy Service */

	// since this is simulation
        net_id_counts++;
    }
}

/* Register the scanner callback during initialization */
static struct bt_le_scan_cb scan_cb = {
	.recv = scan_packet_recv,
};

void bt_mesh_tst_provision(uint16_t addr)
{
	int err;

	/* Each device's device key is dddd...<addr> */
	dev_key[0] = addr & 0xFF;
	dev_key[1] = addr >> 8;

	err = bt_mesh_provision(net_key, net_idx, 0, 0, addr, dev_key);
	if (err) {
		FAIL("Provisioning failed (err %d)", err);
		return;
	}

	LOG_INF("Device provisioned. Addr: 0x%04x", addr);
}

void bt_mesh_tst_common_configure(uint16_t addr)
{
	uint8_t status;
	int err;

	/* Add App Key */
	err = bt_mesh_cfg_cli_app_key_add(net_idx, addr, net_idx, app_idx, app_key,
					  &status);
	if (err || status) {
		FAIL("AppKey add failed (err %d, status %u)", err, status);
		return;
	}

	/* Change default TTL to suit the maximum network size*/
	uint8_t ttl_status;
	err = bt_mesh_cfg_cli_ttl_set(net_idx, addr, MAX_TTL, &ttl_status);
	if (err) {
		FAIL("Default TTL set failed (err %d, status %u)", err, status);
		return;
	}

	ASSERT_TRUE_MSG(ttl_status == MAX_TTL, "TTL status %u != %u", ttl_status, MAX_TTL);

	bt_mesh_proxy_identity_enable();
	bt_le_scan_cb_register(&scan_cb);
}

/* Track Proxy advertisement counts */
static struct k_work_delayable netid_adv_cnt_work;
static int64_t advcnt_t1, advcnt_t2;

static void net_id_count_work_handler(struct k_work *work)
{
	ARG_UNUSED(work);

	static int prev = 0;

	LOG_INF("Proxy adv count: %d / sec", (net_id_counts - prev) / CONNADV_CNT_INT_SEC);
	prev = net_id_counts;
	k_work_schedule(&netid_adv_cnt_work, K_SECONDS(CONNADV_CNT_INT_SEC));
}

void bt_mesh_tst_conn_adv_cnt_init(void)
{
	advcnt_t1 = k_uptime_get();
	k_work_init_delayable(&netid_adv_cnt_work, net_id_count_work_handler);
	k_work_schedule(&netid_adv_cnt_work, K_SECONDS(CONNADV_CNT_INT_SEC));
}

void bt_mesh_tst_conn_adv_cnt_finish(void)
{
	advcnt_t2 = k_uptime_get();
	k_work_cancel_delayable(&netid_adv_cnt_work);
	LOG_INF("Total connetable ADVs observed: %d (%d / seconds)",
		net_id_counts, (net_id_counts / ((advcnt_t2 - advcnt_t1)/1000)));
}


void bt_mesh_device_setup(const struct bt_mesh_prov *prov, const struct bt_mesh_comp *comp)
{
	int err;

	err = bt_enable(NULL);
	if (err) {
		FAIL("Bluetooth init failed (err %d)", err);
		return;
	}

	LOG_INF("Bluetooth initialized");

	err = bt_mesh_init(prov, comp);
	if (err) {
		FAIL("Initializing mesh failed (err %d)", err);
		return;
	}

	if (IS_ENABLED(CONFIG_BT_SETTINGS)) {
		LOG_INF("Loading stored settings");
		if (IS_ENABLED(CONFIG_BT_MESH_USES_MBEDTLS_PSA)) {
			settings_load_subtree("itsemul");
		}
		settings_load_subtree("bt");
	}

	LOG_INF("Mesh initialized");
}

void bt_mesh_test_timeout(bs_time_t HW_device_time)
{
	if (bst_result != Passed) {
		FAIL("Test timeout (not passed after %i seconds)",
		     HW_device_time / USEC_PER_SEC);
	}

	bs_trace_silent_exit(0);
}

void bt_mesh_test_cfg_set(int wait_time)
{
	bst_ticker_set_next_tick_absolute(wait_time * USEC_PER_SEC);
	bst_result = In_progress;

	/* Ensure those test devices will not drift more than
	 * 100ms for each other in emulated time
	 */
	tm_set_phy_max_resync_offset(100000);
}

/* Parse DUT list from string like "0,2,5,6" */
void parse_dut_list(const char *dut_str, int *dut_list_out, int *dut_count_out)
{
	char *str_copy, *token, *saveptr;
	int idx = 0;
	int max_duts = *dut_count_out;

	if (!dut_str || !dut_str[0]) {
		*dut_count_out = 0;
		return;  /* Empty string - will test all nodes */
	}

	/* Make a copy since strtok_r modifies the string */
	str_copy = strdup(dut_str);
	if (!str_copy) {
		FAIL("Failed to allocate memory for DUT list parsing");
		return;
	}

	/* Parse comma-separated values */
	token = strtok_r(str_copy, ",", &saveptr);
	while (token && idx < max_duts) {
		dut_list_out[idx] = atoi(token);
		idx++;
		token = strtok_r(NULL, ",", &saveptr);
	}

	*dut_count_out = idx;
	free(str_copy);
}

/* Check if a device index is in the DUT list */
bool is_dut(int device_idx, int *dut_list, uint32_t dut_count)
{
	/* If no DUTs specified, test all devices */
	if (dut_count == 0 || dut_list == NULL) {
		return true;
	}

	for (uint32_t i = 0; i < dut_count; i++) {
		if (dut_list[i] == device_idx) {
			return true;
		}
	}
	return false;
}

void print_common_results(int total_nodes, int max_iterations)
{
	/* Print average latency */
	LOG_INF("Tester (0x%04x) and each of the devices exchanged %d messages", total_nodes,
		max_iterations);
	LOG_INF("Average round-trip latency for acknowledged messages:");

	for (int dut = 0; dut < total_nodes; dut++) {
		/* Skip if not in DUT list */
		if (!is_dut(dut, dut_list, dut_count)) {
			continue;
		}

		char latency_str[MAX_ITERATIONS * 10 + 100] = {0};
		int64_t avg_latency = 0;
		int offset = 0;

		for (int i = 0; i < max_iterations; i++) {
			avg_latency += tst_res[dut].latency[i];
		}

		avg_latency = avg_latency / max_iterations;

		offset = sprintf(latency_str,
			"Dev %d addr 0x%04x avg latency: %3lld ms failures %d # values: ",
			dut, tst_res[dut].addr, avg_latency, tst_res[dut].failures);

		for (int i = 0; i < max_iterations; i++) {
			offset += sprintf(latency_str + offset, "%lld ", tst_res[dut].latency[i]);
		}

		LOG_INF("%s", latency_str);
	}
}
```

## src/mesh_test.h
```c
/** @file
 *  @brief Common functionality for Bluetooth Mesh BabbleSim tests.
 */

/*
 * Copyright (c) 2025 Nordic Semiconductor ASA
 *
 * SPDX-License-Identifier: Apache-2.0
 */
#ifndef ZEPHYR_TESTS_BSIM_BT_MESH_NW_SIM_H_
#define ZEPHYR_TESTS_BSIM_BT_MESH_NW_SIM_H_

#include <zephyr/bluetooth/mesh.h>

#include "bs_types.h"
#include "bstests.h"


/* This must not be reduced, as these macros are used to initialize max buffers for holding
 * test results.
 */
#define MAX_ITERATIONS  (100)
#define MAX_DEVICES 	(100)

/* Print connectable adv (proxy advs) counts at this interval */
#define CONNADV_CNT_INT_SEC (600)

/* Messages can travel up to 9 hops */
#define MAX_TTL 	(9)

/* Default number of iterations */
#define DEF_ITERATIONS 	(10)

/* Test results */
struct test_results {
	uint16_t d_id;
	uint16_t addr;
	uint16_t failures;
	int64_t latency[MAX_ITERATIONS];
	uint8_t ttl[MAX_ITERATIONS];
};

#define MODEL_LIST(...) ((const struct bt_mesh_model[]){ __VA_ARGS__ })

#define FAIL(msg, ...)                                                         \
	do {                                                                   \
		bst_result = Failed;                                           \
		bs_trace_error_time_line(msg "\n", ##__VA_ARGS__);             \
	} while (0)

#define PASS()                                                                 \
	do {                                                                   \
		bst_result = Passed;                                           \
		bs_trace_info_time(1, "%s PASSED\n", __func__);                \
	} while (0)

#define ASSERT_TRUE_MSG(cond, fmt, ...)                                        \
	do {                                                                   \
		if (!(cond)) {                                                 \
			bst_result = Failed;                                   \
			bs_trace_error_time_line(                              \
				#cond " is false. " fmt, ##__VA_ARGS__);       \
		}                                                              \
	} while (0)


extern enum bst_result_t bst_result;
void bt_mesh_test_timeout(bs_time_t HW_device_time);

void bt_mesh_tst_provision(uint16_t addr);
void bt_mesh_tst_common_configure(uint16_t addr);
void bt_mesh_device_setup(const struct bt_mesh_prov *prov, const struct bt_mesh_comp *comp);
void bt_mesh_test_cfg_set(int wait_time);
void bt_mesh_tst_conn_adv_cnt_init(void);
void bt_mesh_tst_conn_adv_cnt_finish(void);

/* Parse DUT list from string like "0,2,5,6" */
void parse_dut_list(const char *dut_str, int *dut_list_out, int *dut_count_out);

/* Check if a device index is in the DUT list */
bool is_dut(int device_idx, int *dut_list, uint32_t dut_count);

void print_common_results(int total_nodes, int max_iterations);

#endif /* ZEPHYR_TESTS_BSIM_BT_MESH_NW_SIM_H_ */
```
